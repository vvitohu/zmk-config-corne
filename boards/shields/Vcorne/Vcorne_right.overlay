#include "Vcorne.dtsi"

&default_transform {
    col-offset = <6>;
};

&kscan0 {
    col-gpios
        = <&pro_micro  4 GPIO_ACTIVE_HIGH>
        , <&pro_micro  5 GPIO_ACTIVE_HIGH>
        , <&pro_micro  6 GPIO_ACTIVE_HIGH>
        , <&pro_micro  7 GPIO_ACTIVE_HIGH>
        , <&pro_micro  8 GPIO_ACTIVE_HIGH>
        , <&pro_micro  9 GPIO_ACTIVE_HIGH>
    ; 

    right_encoder: encoder_right {
        compatible = "alps,ec11";
        a-gpios = <&pro_micro 2 (GPIO_ACTIVE_HIGH | GPIO_PULL_UP)>;
        b-gpios = <&pro_micro 3 (GPIO_ACTIVE_HIGH | GPIO_PULL_UP)>;
        steps = <80>;
        status = "okay";
    };
};
