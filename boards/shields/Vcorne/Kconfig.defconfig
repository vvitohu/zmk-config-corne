## boards/shields/Vcorne/Kconfig.defconfig
```kconfig
if SHIELD_VCORNE_LEFT

config ZMK_KEYBOARD_NAME
    default "VCorne"

config ZMK_SPLIT_ROLE_CENTRAL
    default y

endif

if SHIELD_VCORNE_LEFT || SHIELD_VCORNE_RIGHT

config ZMK_SPLIT
    default y

CONFIG_ZMK_IDLE_TIMEOUT=30

config ZMK_SLEEP
    default y
    
config ZMK_IDLE_SLEEP_TIMEOUT
    default 3600

  
config ZMK_EXT_POWER
    default y

config ZMK_BATTERY_REPORTING
    default y
    
config ZMK_BATTERY_REPORT_INTERVAL
    default 60

endif
```

## boards/shields/Vcorne/Kconfig.shield
```kconfig
# Copyright (c) 2020 The ZMK Contributors
# SPDX-License-Identifier: MIT

# No whitespace after the comma or in your part name!
config SHIELD_VCORNE_LEFT
    def_bool $(shields_list_contains,Vcorne_left)

# No whitespace after the comma or in your part name!
config SHIELD_VCORNE_RIGHT
    def_bool $(shields_list_contains,Vcorne_right)
```
